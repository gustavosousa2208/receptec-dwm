/* SPDX-License-Identifier: Apache-2.0 */

/dts-v1/;
#include <nordic/nrf52833_qdaa.dtsi>
#include "../common/dwm3001cdk-pinctrl.dtsi"
#include "../common/dwm3001cdk.dtsi"

/ {
	model = "Atletec fake-COLETEC-1 UWB bench surrogate";
	compatible = "atletec,fake-coletec-1-bench";
};
