## boards/atletec/coletec/board.yml
```yaml
boards:
  - name: fake_coletec_0
    full_name: fake-COLETEC-0 UWB bench surrogate
    vendor: atletec
    socs:
      - name: nrf52833
  - name: fake_coletec_1
    full_name: fake-COLETEC-1 UWB bench surrogate
    vendor: atletec
    socs:
      - name: nrf52833
```

## boards/atletec/receptec/board.yml
```yaml
boards:
  - name: receptec
    full_name: Atletec RECEPTEC Type2AB receiver
    vendor: atletec
    socs:
      - name: nrf52840
```

## boards/atletec/receptec_qorvo/board.yml
```yaml
boards:
  - name: receptec_qorvo
    full_name: RECEPTEC-Qorvo UWB receiver
    vendor: atletec
    socs:
      - name: nrf52833
```
